## Kconfig
```kconfig
# Read by ESP-IDF as a component Kconfig, and by both forges' `make menu`
# (scripts/menu.py) for the CAN_<CHIP> prompts. stm-forge has no Kconfig
# build step: its build only sees the defconfig lines, as
# -DCONFIG_CAN_<CHIP>=1 or 0. Every chip is off unless set.
menuconfig CAN
    bool "CAN subsystem (Classic CAN; CAN FD on the FDCAN)"
    default y
    help
        The CAN core: struct can_dev, can_send() and can_recv() and
        their CAN FD forms, filters, status, and the can_* log helpers.
        Pick the controller drivers you need below; none is built by
        default, so a chip missing from sdkconfig is off.

if CAN

    config CAN_MCP2515
        bool "Microchip MCP2515 (SPI)"
        default n
        help
            Build the MCP2515 driver: mcp2515_init() and the mcp2515_*
            calls of esp-mcp2515-can, the same on the STM32 HAL, and
            mcp2515_can().

    config CAN_TWAI
        bool "ESP32 TWAI controller (ESP-IDF only)"
        default n
        help
            Build the TWAI driver on ESP-IDF's legacy driver/twai.h:
            twaican_init() and twaican_can(). Not for a controller
            esp-sn65hvd230-can already drives: one owner per controller.

    config CAN_BXCAN
        bool "STM32 bxCAN controller (STM32 HAL only)"
        default n
        help
            Build the bxCAN driver on the HAL's CAN module: bxcan_init()
            and bxcan_can(). Needs HAL_CAN_MODULE_ENABLED and
            stm32<family>xx_hal_can.c in the build. Ignored on ESP-IDF.

    config CAN_FDCAN
        bool "STM32 FDCAN controller, Classic CAN and CAN FD (STM32 HAL only)"
        default n
        help
            Build the FDCAN driver on the HAL's FDCAN module: fdcan_init(),
            fdcan_irq() and fdcan_can(), with can_send_fd() and
            can_recv_fd() for CAN FD frames. Needs HAL_FDCAN_MODULE_ENABLED
            and stm32<family>xx_hal_fdcan.c in the build. Checked against
            the STM32H5 HAL. Ignored on ESP-IDF.

    config CAN_DEBUG
        bool "can_dbg() lines"
        default n
        help
            STM32 HAL only: compile can_dbg() lines in. On ESP-IDF
            can_dbg() is ESP_LOGD and the log level decides.

endif # CAN
```
